## main/Kconfig.projbuild
```kconfig
menu "Amyai 配置"

    config AMYAI_WIFI_SSID
        string "Wi-Fi 名称 (SSID)"
        default ""
        help
            要连接的 Wi-Fi 名称，区分大小写。

    config AMYAI_WIFI_PASSWORD
        string "Wi-Fi 密码"
        default ""
        help
            要连接的 Wi-Fi 密码；开放网络请留空。

    config AMYAI_LLM_API_KEY
        string "大模型 API Key"
        default ""
        help
            智谱 GLM 的 API Key（形如 xxxxx.yyyyy）。
            注意：量产版本不要把 Key 烧进固件，应走自有中转服务。

endmenu

menu "Amyai 音频硬件"

    config AMYAI_I2C_SDA
        int "ES8311 I2C SDA 引脚"
        default 48

    config AMYAI_I2C_SCL
        int "ES8311 I2C SCL 引脚"
        default 45

    config AMYAI_I2S_MCLK
        int "I2S MCLK 引脚（-1 = 不使用）"
        default -1

    config AMYAI_I2S_BCLK
        int "I2S BCLK 引脚（-1 = 未配置）"
        default -1

    config AMYAI_I2S_WS
        int "I2S WS/LRCK 引脚（-1 = 未配置）"
        default -1

    config AMYAI_I2S_DIN
        int "I2S DIN 引脚（codec 数据进 ESP32，-1 = 未配置）"
        default -1

    config AMYAI_I2S_DOUT
        int "I2S DOUT 引脚（ESP32 数据进 codec，-1 = 未配置）"
        default -1


endmenu

menu "Amyai 唤醒词"

    config AMYAI_WAKE_MODEL
        string "WakeNet 模型名"
        default "wn9_xiaoluxiaolu_tts2"
        help
            esp-sr 的 WakeNet 模型名。可选值见 esp-sr/wakeword_list.md。
            例如：
              wn9_xiaoluxiaolu_tts2   -> 小鹿小鹿
              wn9_xiaolongxiaolong_tts -> 小龙小龙
              wn9_nihaoxiaozhi_tts     -> 你好小智
            注意：换成自制模型时，除了这里，还要在 menuconfig 的
            ESP Speech Recognition 里勾选对应的模型，才能打包进 model 分区。

    config AMYAI_WAKE_TEXT
        string "唤醒词文字（仅用于日志显示）"
        default "小鹿小鹿"

endmenu

menu "Amyai 配网与出厂重置"

    config AMYAI_PROV_ENABLE
        bool "启用网页配网"
        default y
        help
            设备没有保存 Wi-Fi 凭据时自动进入网页配网模式：
            开隐藏 AP（AMYAI-CHAIR）+ HTTP 服务，手机扫码连上后打开
            192.168.4.1 填写 Wi-Fi 和身体信息。
            配网方式已由蓝牙改为网页，不再需要蓝牙协议栈。

    config AMYAI_PROV_RESET_GPIO
        int "恢复出厂按键 GPIO（-1 = 不使用）"
        default 0
        help
            开机时按住这个按键（低电平有效）超过设定时间，会清除已保存的
            Wi-Fi 凭据和用户信息，下次启动重新进入网页配网模式。
            DNESP32S3B 的 BOOT 键接 GPIO0。

    config AMYAI_PROV_RESET_HOLD_MS
        int "恢复出厂按键按住时长（毫秒）"
        default 3000
        depends on AMYAI_PROV_RESET_GPIO >= 0

    config AMYAI_AUDIO_PROBE
        bool "开机时探测音频引脚电平（硬件排查用）"
        default n
        help
            开机时把麦克风数据脚当普通 GPIO，分别加上拉/下拉各读 200 次，
            用来判断是"线悬空"还是"被拉死"。会额外占用约 0.8 秒启动时间，
            只在硬件排查时打开。

endmenu

menu "Amyai 主控通信（UART）"

    config AMYAI_MUSIC_DUCK_PERCENT
        int "放音乐时压低到的音量百分比（音乐窗口监听用）"
        default 40
        range 5 90
        help
        放音乐时为了让麦克风听清人声，会把音乐音量压低到这个百分比。
        压低越多，越容易识别"换一首/停"这类指令，但音乐越小；
        压低越少，音乐越好听，但人声可能被音乐盖住识别不到。
        实测参考：20% 识别可靠但音乐太小；40% 音乐勉强可听，人声仍能过阈值。

    config AMYAI_UART_ENABLE
        bool "启用 UART 指令发送"
        default y
        help
            开启后，大模型解析出的指令会按双芯片协议打包，通过 UART 发给主控板。
            接法：本板 TX -> 主控 RX，本板 RX <- 主控 TX，并且必须共地。

    config AMYAI_UART_ON_CONSOLE
        bool "协议走调试串口（免接线，仅验证用）"
        default n
        help
            开启后协议帧直接走调试串口 UART0，和日志共用一个口，
            不需要额外接线就能把「指令下发 + ACK」整条链路验证一遍。
            注意：日志和二进制帧会混在一起，只能用于调试；
            正式产品必须关掉它，用独立的 UART1 和主控通信。

    config AMYAI_UART_PIN_SCAN
        bool "扫描模式：逐个引脚试 TX，找出接线实际在哪"
        default n
        help
            开启后不按配置的引脚工作，而是每隔 2 秒把 UART1 的 TX 换到
            IO5 / IO6 / IO8 / IO18（这块板子上仅有的 4 个空闲 IO），
            并在 payload 里带上引脚号。
            接线那头用什么工具看，哪个口冒出数据，就说明接的是那个引脚。
            找到后关掉本项、把 AMYAI_UART_TX_GPIO 设成对应值即可。

    config AMYAI_UART_TX_GPIO
        int "UART TX 引脚（接主控 RX）"
        default 17
    config AMYAI_UART_RX_GPIO
        int "UART RX 引脚（接主控 TX）"
        default 18

    config AMYAI_UART_BAUD
        int "波特率"
        default 115200

    config AMYAI_UART_ACK_TIMEOUT_MS
        int "等待 ACK 超时（毫秒）"
        default 300
        range 50 2000

    config AMYAI_UART_REQUIRE_ACK
        bool "要求主控返回 ACK（关闭则只管发，不等确认）"
        default y
        help
        打开：每条指令都等主控回 ACK，300ms 没回就重传，3 次失败报"未送达"。
        关闭：发出去就算完成，不等回执、不重传。单板联调 / 主控是模拟器时关掉它，
        否则日志会一直刷"没有 ACK"。

    config AMYAI_UART_RETRIES
        int "重传次数"
        default 3
        range 1 10

    config AMYAI_UART_HEARTBEAT
        bool "发送心跳帧"
        default y
        help
            每秒发一次 type=0x03 心跳，主控 3 秒收不到会停机（安全兜底）。

    config AMYAI_UART_HEARTBEAT_MS
        int "心跳间隔（毫秒）"
        default 1000
        range 200 5000

endmenu

menu "Amyai 语音合成（TTS）"

    config AMYAI_TTS_API_KEY
        string "百炼 API Key（sk- 开头）"
        default ""
        help
            阿里云百炼（DashScope）的 API Key，用于 qwen3-tts-flash 语音合成。
            留空则聊天/播报功能不可用（其余功能不受影响）。

    config AMYAI_TTS_MODEL
        string "TTS 模型"
        default "qwen3-tts-flash"

    config AMYAI_TTS_VOICE
        string "音色"
        default "Cherry"
        help
            常用音色：Cherry（女声）、Ethan（男声）等，完整列表见百炼文档。

    config AMYAI_TTS_CONFIRM
        bool "控制指令成功后语音确认"
        default y
        help
            下发指令并收到主控 ACK 之后，播报一句"好的，帮你按肩膀"这样的确认语。
            关闭后控制类指令完全静默（更快，但用户不知道有没有执行）。

    config AMYAI_TTS_RATE_PCT
        int "语速（百分比，100 = 正常）"
        default 80
        range 40 150
        help
            板载小喇叭音量小、低频重，正常语速容易听不清，默认放慢到 80%。
            觉得太慢可以调到 90 或 100；觉得还不够清楚可以降到 70。

endmenu

menu "Amyai 交互"

    config AMYAI_FOLLOW_UP_SEC
        int "连续对话保持时长（秒）"
        default 600
        range 3 3600
        help
            回复完之后继续聆听多久。这段时间内用户不需要再喊唤醒词。
            设大（比如 600）适合"一直陪聊"；设小（10~30）更省流量、更不容易被电视等背景音误触发。

endmenu

menu "Amyai 音乐"

    config AMYAI_MUSIC_BASE_URL
        string "音乐资源根地址"
        default "http://192.168.1.119:8000"
        help
            音乐文件的 HTTP 根地址。开发期可以指向电脑上的本地服务，
            正式期换成 OSS/CDN 地址。曲库文件名目前硬编码在 music_player.cpp。

endmenu

menu "Amyai 排查开关"

    config AMYAI_SKIP_WIFI_FOR_TEST
        bool "测试：跳过 WiFi（只跑麦克风，排查断流）"
        default n
        help
            开启后开机不连 WiFi，只启动唤醒/录音链路。
            用来判断麦克风断流是否和 WiFi/射频/供电有关。

endmenu
```

## sdkconfig.defaults
```kconfig
# 目标芯片：ESP32-S3
CONFIG_IDF_TARGET="esp32s3"

# 板子为 16MB Flash / 8MB PSRAM / 240MHz
CONFIG_ESPTOOLPY_FLASHSIZE_16MB=y
CONFIG_ESPTOOLPY_FLASHSIZE="16MB"
CONFIG_ESP_DEFAULT_CPU_FREQ_MHZ_240=y

# esp-sr 的唤醒词模型需要大量内存，必须开 PSRAM（八线 8MB）
CONFIG_SPIRAM=y
CONFIG_SPIRAM_MODE_OCT=y
CONFIG_SPIRAM_SPEED_80M=y

# 自定义分区表：带一个 model 分区给 esp-sr 放模型
CONFIG_PARTITION_TABLE_CUSTOM=y
CONFIG_PARTITION_TABLE_CUSTOM_FILENAME="partitions.csv"

# 唤醒词模型：小鹿小鹿（换成别的模型时，这里和下面的 AMYAI_WAKE_MODEL 一起改）
CONFIG_SR_WN_WN9_XIAOLUXIAOLU_TTS2=y
CONFIG_AMYAI_WAKE_MODEL="wn9_xiaoluxiaolu_tts2"
CONFIG_AMYAI_WAKE_TEXT="小鹿小鹿"

# BLE 配网需要蓝牙协议栈：用 NimBLE（比 Bluedroid 省 RAM，配网完还会整块释放）
CONFIG_BT_ENABLED=y
CONFIG_BT_NIMBLE_ENABLED=y
# ESP-IDF 6.x 默认关闭 protocomm 安全版本 1，配网用 PoP 必须显式打开
CONFIG_ESP_PROTOCOMM_SUPPORT_SECURITY_VERSION_1=y
CONFIG_AMYAI_PROV_ENABLE=y
CONFIG_AMYAI_PROV_POP="abcd1234"
CONFIG_AMYAI_PROV_NAME_PREFIX="AMYAI"
CONFIG_AMYAI_PROV_TIMEOUT_SEC=300
CONFIG_AMYAI_PROV_RESET_GPIO=0
CONFIG_AMYAI_PROV_RESET_HOLD_MS=3000

# 音频引脚：默认未配置（-1），确定后在这里填，或用 menuconfig 改
CONFIG_AMYAI_I2C_SDA=48
CONFIG_AMYAI_I2C_SCL=45
CONFIG_AMYAI_I2S_MCLK=-1
CONFIG_AMYAI_I2S_BCLK=21
CONFIG_AMYAI_I2S_WS=13
CONFIG_AMYAI_I2S_DIN=47
CONFIG_AMYAI_I2S_DOUT=14
CONFIG_AMYAI_PA_PIN=-1

# 下面三项含敏感信息，故意留空。
# 实际值只写在 sdkconfig 里（已在 .gitignore 中），不要提交到仓库。
CONFIG_AMYAI_WIFI_SSID=""
CONFIG_AMYAI_WIFI_PASSWORD=""
CONFIG_AMYAI_LLM_API_KEY=""
# 离线命令词识别（MultiNet7 中文）：唤醒后先本地识别，未命中再走云端
# 模型包约 2.8MB，需要 model 分区 >= 4MB（见 partitions.csv）
CONFIG_SR_MN_CN_MULTINET7_QUANT=y
CONFIG_SR_MN_LOAD_MODE_PSRAM_FLASH=y

# TTS / ASR 的 Key 同样不入库
```
